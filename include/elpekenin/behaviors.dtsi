#include "elpekenin/__dts/behaviors/gpio.dtsi"
#include "elpekenin/__dts/behaviors/default_layer.dtsi"

#define LED_NUM_LOCK    0x01
#define LED_CAPS_LOCK   0x02
#define LED_SCROLL_LOCK 0x04
#define LED_COMPOSE     0x08
#define LED_KANA        0x10