## Kconfig
```kconfig
config ELPEKENIN_LAYER_CALLBACK
    bool
    default y
    depends on DT_HAS_ELPEKENIN_LAYER_CALLBACK_ENABLED

config TBOG_LOCK_INDICATOR
    bool "TBog Lock indicator"
    select ZMK_HID_INDICATORS
    default y
    depends on DT_HAS_TBOG_LOCK_INDICATOR_ENABLED
    
rsource "Kconfig.behaviors"
```

## dts/bindings/tbog,lock-indicator.yaml
```yaml
# Copyright (c) 2024 The ZMK Contributors
# SPDX-License-Identifier: MIT

description: Enable gpio/led behavior(s) when a lock (caps/scroll/num/etc.) is activated
compatible: "tbog,lock-indicator"
properties:
  gpios:
    type: phandle-array
    required: true
    description: GPIO pin(s) for the LED.
  indicator-mask:
    type: int
    required: false
    description: Bitmask of HID indicators to monitor.
```
